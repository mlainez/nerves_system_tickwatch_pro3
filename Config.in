## packages/android-gps-compat/Config.in
```kconfig
config BR2_PACKAGE_ANDROID_GPS_COMPAT
	bool "android-gps-compat"
	depends on BR2_aarch64
	select BR2_PACKAGE_BCM4775_DRIVER
	help
	  Compatibility launcher and 32-bit Android HAL bridge for the
	  Broadcom BCM4775 GNSS stack retained on the TicWatch's stock
	  system and vendor partitions.

	  No proprietary Android files are included. The partitions are
	  mounted read-only at runtime and GPS is only started on demand.
```

## packages/bcm4775-driver/Config.in
```kconfig
config BR2_PACKAGE_BCM4775_DRIVER
	bool "bcm4775-driver [TicWatch Pro 3]"
	depends on BR2_LINUX_KERNEL
	select BR2_PACKAGE_KMOD
	help
	  Linux 7.1 port of Mobvoi's Broadcom BBD/SPI transport for the
	  BCM4775 GNSS receiver. It exposes /dev/ttyBCM and the
	  /dev/bbd_* bridge devices. A location fix additionally requires a
	  userspace Broadcom location engine, which is not included.
```

## packages/citronics-initramfs/Config.in
```kconfig
config BR2_PACKAGE_CITRONICS_INITRAMFS
        bool "citronics-initramfs [TicWatch Pro 3]"
        depends on !BR2_STATIC_LIBS
        depends on BR2_USE_MMU
        depends on BR2_TOOLCHAIN_HAS_THREADS
        depends on BR2_INSTALL_LIBSTDCPP
        select BR2_PACKAGE_BUSYBOX
        select BR2_PACKAGE_UNUDHCPD
        select BR2_PACKAGE_MULTIPATH_TOOLS
        select BR2_PACKAGE_PARTED
        select BR2_PACKAGE_E2FSPROGS
        select BR2_PACKAGE_E2FSPROGS_RESIZE2FS
        select BR2_PACKAGE_UTIL_LINUX_BINARIES
        help
          Early-boot initramfs. lk2nd loads it alongside the kernel; it
          maps the Nerves subpartitions out of the stock `userdata`
          partition with kpartx, mounts the squashfs rootfs and pivots
          into it. If any of that fails it brings up USB networking and
          a telnet shell instead of leaving you with a black screen.

          Patched here to find `userdata` by GPT name rather than by a
          hardcoded eMMC partition number — see the package's 0003 patch.
```

## packages/nanohub-driver/Config.in
```kconfig
config BR2_PACKAGE_NANOHUB_DRIVER
	bool "nanohub-driver [TicWatch Pro 3]"
	depends on BR2_LINUX_KERNEL
	select BR2_PACKAGE_KMOD
	help
	  Port of Mobvoi's Android nanohub SPI transport for Linux 7.1.
	  It exposes /dev/nanohub, /dev/nanohub_comms,
	  /dev/nanohub_hr_log and /dev/nanohub_custom_flash, plus the
	  nanohubctl utility for heart-rate, accelerometer and gyroscope
	  access. The package never installs or flashes hub firmware.
```

## packages/ticwatch-pro3-firmware/Config.in
```kconfig
config BR2_PACKAGE_TICWATCH_PRO3_FIRMWARE
	bool "ticwatch-pro3-firmware [TicWatch Pro 3]"
	select BR2_PACKAGE_LINUX_FIRMWARE
	select BR2_PACKAGE_LINUX_FIRMWARE_BRCM_BCM43XXX
	help
	  Wi-Fi and Bluetooth firmware plumbing for the Broadcom
	  BCM43430A1 in the TicWatch Pro 3.

	  Two halves, because they come from different places:

	  The chip firmware itself is redistributable and comes from
	  linux-firmware. Upstream ships it as cypress/cyfmac43430-sdio.bin
	  with brcm/brcmfmac43430-sdio.bin as a symlink; Buildroot installs
	  the real file but not the symlink, so this package adds it.

	  The calibration data does not come from linux-firmware. The Wi-Fi
	  NVRAM and the Bluetooth patch RAM image are specific to the board
	  — in the NVRAM's case, to the individual watch, since it carries
	  the MAC address — and live on the stock Android partitions. They
	  cannot be shipped here. ticwatch-bringup finds them at boot
	  on the read-only /mnt/vendor and /mnt/persist mounts and presents
	  them under the names brcmfmac and hci_bcm ask for.

	  Without the NVRAM, brcmfmac will load and then fail to bring the
	  interface up. See the README.
```
